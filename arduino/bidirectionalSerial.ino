
// #include <SPI.h> // Comment out when using i2c
#include <Wire.h>
#include <Adafruit_GFX.h>
#include <Adafruit_SSD1306.h>
#include <ParallaxJoystick.hpp>;

// 'bullet', 33x60px
const unsigned char myBitmap [] PROGMEM = {
  0x00, 0x00, 0x00, 0x00, 0x00, 0x00, 0x07, 0xf0, 0x00, 0x00, 0x00, 0x1f, 0xfc, 0x00, 0x00, 0x00, 
  0x38, 0x0e, 0x00, 0x00, 0x00, 0x70, 0x07, 0x00, 0x00, 0x00, 0xe0, 0x03, 0x80, 0x00, 0x00, 0xc0, 
  0x01, 0xc0, 0x00, 0x01, 0x80, 0x00, 0xc0, 0x00, 0x03, 0x00, 0x00, 0x60, 0x00, 0x03, 0x00, 0x00, 
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  0xf8, 0x00, 0x0f, 0xff, 0xff, 0xf8, 0x00, 0x00, 0x00, 0x00, 0x00, 0x00
};

#define SCREEN_WIDTH 128 // OLED display width, in pixels
#define SCREEN_HEIGHT 64 // OLED display height, in pixels

// Declaration for an SSD1306 display connected to I2C (SDA, SCL pins)
#define OLED_RESET     4 // Reset pin # (or -1 if sharing Arduino reset pin)
Adafruit_SSD1306 _display(SCREEN_WIDTH, SCREEN_HEIGHT, &Wire, OLED_RESET);

const int DELAY_MS = 5;
const long BAUD_RATE = 115200;
const int OUTPUT_PIN = 9;
const int JOYSTICK_UPDOWN_PIN = A1;
const int JOYSTICK_LEFTRIGHT_PIN = A0;

const int MAX_ANALOG_VAL = 1023;
const enum JoystickYDirection JOYSTICK_Y_DIR = RIGHT;

// Analog joystick for left player
ParallaxJoystick _analogJoystick(JOYSTICK_UPDOWN_PIN, JOYSTICK_LEFTRIGHT_PIN, MAX_ANALOG_VAL, JOYSTICK_Y_DIR);

int _bullets = 3;
int _prevJoystickVal = 500;

void setup() {
  Serial.begin(BAUD_RATE);

  pinMode(OUTPUT_PIN, OUTPUT);

  // SSD1306_SWITCHCAPVCC = generate display voltage from 3.3V internally
  if(!_display.begin(SSD1306_SWITCHCAPVCC, 0x3D)) { // Address 0x3D for 128x64
    Serial.println(F("SSD1306 allocation failed"));
    for(;;); // Don't proceed, loop forever
  }

  _display.clearDisplay();
  _display.setTextSize(1);      // Normal 1:1 pixel scale
  _display.setTextColor(SSD1306_WHITE); // Draw white text
  _display.setCursor(0, 0);     // Start at top-left corner
  _display.print("Waiting to receive\ndata from serial...");
  _display.display();
}

void loop() {
  // Check to see if there is any incoming serial data
  if(Serial.available() > 0){
    // If we're here, then serial data has been received
    // Read data off the serial port until we get to the endline delimeter ('\n')
    // Store all of this data into a string
    String rcvdSerialData = Serial.readStringUntil('\n'); 
    int numBullets = rcvdSerialData.toInt();
    if (numBullets != 0) {
      _bullets = numBullets;
    }
  }

  _display.clearDisplay();

  // Read analog joystick
  _analogJoystick.read();
  int leftRightVal = _analogJoystick.getLeftRightVal();
  if (leftRightVal > 600 && _prevJoystickVal < 600) {
    _bullets -= 1;
  } else if (leftRightVal < 400 && _prevJoystickVal > 400) {
    _bullets += 1;
  }
  _prevJoystickVal = leftRightVal;

  if (_bullets > 0) {
    _display.drawBitmap(7, 2,  myBitmap, 33, 60, WHITE);
  }
  if (_bullets > 1) {
    _display.drawBitmap(47, 2,  myBitmap, 33, 60, WHITE);
  }
  if (_bullets > 2) {
    _display.drawBitmap(87, 2,  myBitmap, 33, 60, WHITE);
  }

  Serial.println(_bullets);

  _display.display();
}
